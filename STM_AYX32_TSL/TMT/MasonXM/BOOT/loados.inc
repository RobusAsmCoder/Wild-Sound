CMD.COM1                                        EQU 192
CMD.COM2                                        EQU 198
CMD.COM3                                        EQU 206
CMD.COM4                                        EQU 212
CMD.COM5                                        EQU 220
CMD.COM6                                        EQU 226
CMD.II                                          EQU 232
CMD.I                                           EQU 236
CMD.L                                           EQU 0
CMD.U                                           EQU 5
CMD.X                                           EQU 26
CMD.XX                                          EQU 31
CMD.E                                           EQU 36
CMD.GG                                          EQU 64
CMD.G                                           EQU 71
CMD.P                                           EQU 87
CMD.T                                           EQU 97
CMD.K                                           EQU 100
LOD.START                                       EQU 16384
LOD.END                                         EQU 17385
LOD.SIZE                                        EQU 1001
LOA.KEY                                         EQU 17334
LOA.CRC                                         EQU 17332
LOADER.XARAADR                                  EQU 16875
LOADER.XARAPAG                                  EQU 16879
LOADER.XARASKIP                                 EQU 16909
LOADER.OUTPAGEADDR                              EQU 16836
