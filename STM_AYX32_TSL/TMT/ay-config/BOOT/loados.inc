CMD.COM1                                        EQU 192
CMD.COM2                                        EQU 198
CMD.COM3                                        EQU 206
CMD.COM4                                        EQU 212
CMD.COM5                                        EQU 220
CMD.COM6                                        EQU 226
CMD.II                                          EQU 232
CMD.I                                           EQU 236
CMD.L                                           EQU 0
CMD.U                                           EQU 5
CMD.X                                           EQU 26
CMD.XX                                          EQU 31
CMD.E                                           EQU 36
CMD.GG                                          EQU 58
CMD.G                                           EQU 65
CMD.P                                           EQU 81
CMD.T                                           EQU 91
CMD.K                                           EQU 94
LOD.START                                       EQU 16384
LOD.END                                         EQU 17365
LOD.SIZE                                        EQU 981
LOA.KEY                                         EQU 17314
LOA.CRC                                         EQU 17312
LOADER.XARAADR                                  EQU 16862
LOADER.XARAPAG                                  EQU 16866
LOADER.XARASKIP                                 EQU 16896
LOADER.OUTPAGEADDR                              EQU 16823
